## boards/shields/v2/Kconfig.defconfig
```kconfig
if SHIELD_V2_LEFT

config ZMK_KEYBOARD_NAME
    default "v2"

endif

if SHIELD_V2_LEFT || SHIELD_V2_RIGHT

config ZMK_SPLIT
    default y

endif
```

## boards/shields/v2/Kconfig.shield
```kconfig
config SHIELD_V2_LEFT
    def_bool $(shields_list_contains,v2_left)
config SHIELD_V2_RIGHT
    def_bool $(shields_list_contains,v2_right)
```
